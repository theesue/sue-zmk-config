/*
  Define the SPI bus for nice!view on nice_nano_v2
  so the builtin nice_view overlay can reference it.
*/

&spi1 {
    status = "okay";

    nice_view_spi: spi@1 {
        compatible = "nordic,nrf-spim";
        pinctrl-0 = <&spi1_default>;
        pinctrl-names = "default";
        sck-pin = <13>;
        mosi-pin = <15>;
        miso-pin = <14>;
        cs-gpios = <&gpio0 6 GPIO_ACTIVE_HIGH>;
        /* Adjust according to your actual CS pin. */
    };
};
