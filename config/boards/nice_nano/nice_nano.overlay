/*
  Enable SPI1 and define the nice_view SPI node so the nice_view
  shield overlay can reference it.
*/

&spi1 {
    status = "okay";

    nice_view_spi: spi@0 {
        compatible = "nordic,nrf-spim";
        pinctrl-0 = <&spi1_default>;
        pinctrl-names = "default";
        cs-gpios = <&gpio0 6 GPIO_ACTIVE_HIGH>;
        reg = <0>;
    };
};